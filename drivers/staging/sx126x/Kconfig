## drivers/staging/sx126x/Kconfig
```kconfig
config SX126X
	tristate "SPI SX126X Device Support"
	depends on SPI
	help
	  This enables support for accessing SX126x devices.
	  If you have SX126X chip say yes.

	  If unsure, say no here.
```
